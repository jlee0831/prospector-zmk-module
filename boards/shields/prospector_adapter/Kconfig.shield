## boards/shields/prospector_adapter/Kconfig.shield
```kconfig
config SHIELD_PROSPECTOR_ADAPTER
    def_bool $(shields_list_contains,prospector_adapter)

config TOUCAN_KEY_HISTORY
    bool "Key history display widget"
    depends on SHIELD_PROSPECTOR_ADAPTER
    default n
```
